## hareware/components/pca9685/Kconfig.projbuild
```kconfig
menu "PCA9685"
    config PCA9685_I2C_ADDR
        hex "PCA9685 I2C address"
        default 0x40
        help
            7-bit I2C address of the PCA9685 module.
endmenu
```

## hareware/components/shared/Kconfig.projbuild
```kconfig
menu "Hareware"

    choice BOARD_ROLE_OVERRIDE
        prompt "Board role (development override)"
        default BOARD_ROLE_AUTO
        help
            Auto: strap GPIO48 + PCA9685 I2C probe (production).
            两块板烧录同一固件，无需改 sdkconfig。

        config BOARD_ROLE_AUTO
            bool "Auto detect at boot"

        config BOARD_ROLE_FORCE_ORACLE
            bool "Force Oracle (WROOM)"

        config BOARD_ROLE_FORCE_CAT
            bool "Force Cat (EYE)"

    endchoice

endmenu
```

## hareware/sdkconfig.defaults
```kconfig
# 统一固件：两块板各烧录同一 hareware.bin，上电自动识别角色
CONFIG_BOARD_ROLE_AUTO=y
CONFIG_ESPTOOLPY_FLASHSIZE_8MB=y
CONFIG_ESPTOOLPY_FLASHSIZE="8MB"
CONFIG_PARTITION_TABLE_SINGLE_APP_LARGE=y
```
